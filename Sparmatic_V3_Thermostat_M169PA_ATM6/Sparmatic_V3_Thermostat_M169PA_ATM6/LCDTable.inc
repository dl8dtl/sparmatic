;------------------------------------------------------------
;LCD alphanumeric chracter segment bit position
LCD_Segment_Table:

;		a	b	c	d	e	f	g1	g2	h	i	j	k	l	m
.db	   126,124, 44,  5,  7,127, 47, 85, 87, 86,125, 45, 46,  6	;left Digit
.db	   123,121,  1,  2,  4, 84, 43, 81, 83, 82,122, 41, 42,  3	;middle left Digit
.db	   137,139, 59, 18, 16,136, 56, 98, 96, 97,138, 58, 57, 17	;middle right Digit
.db	   140,142, 22, 21, 19, 99, 60,102,100,101,141, 62, 61, 20	;right Digit


;------------------------------------------------------------
;LCD alphanumeric chracter bitmap
LCD_Character_Table:
;				 21
;		mlkjih	 ggfedcba
.db	0b00100100,0b00111111		;0
.db	0b00000100,0b00000110		;1
.db	0b00000000,0b11011011		;2
.db	0b00000000,0b10001111		;3
.db	0b00000000,0b11100110		;4
.db	0b00000000,0b11101101		;5
.db	0b00000000,0b11111101		;6
.db	0b00010100,0b00000001		;7
.db	0b00000000,0b11111111		;8
.db	0b00000000,0b11101111		;9
.db	0b00000000,0b11000000		;:	used as '-'
.db	0b00100010,0b00000000		;;
.db	0b00001100,0b00000000		;<
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.db	0b00100100,0b00001001		;Z
;		mlkjih	 ggfedcba

;-----------------------------------------------------------
;Bargraph segment bit position
Bargraph_Table:
.db 88, 48,  8,  9, 49, 89, 90, 50
.db 10, 11, 51, 91, 92, 52, 12, 13
.db	53, 93,134, 94, 54, 14, 15, 55 						


;-----------------------------------------------------------
;Week day bit position
WDayTable:
.db	128,129,130,131,132,133,95,0			;Mo..So


;-----------------------------------------------------------
;Symbol bit position
SymbolTable:
.db 0,80,120,40,23,24,64,104,144,103,143,0 



//End of file//